## arch/arc/drivers/Kconfig
```kconfig
config ARC_IDE
	tristate "Enable ARC IDE"
	select HAVE_IDE
	select IDE
	select BLK_DEV_IDE
	select BLK_DEV_IDEDISK
	depends on ARC_BOARD_ANGEL4
	default y

config ARC_BLK_DEV_IDEDMA
	bool "ARC IDE DMA support"
	default y
	select BLK_DEV_IDEDMA
	depends on ARC_IDE

config ARC_PS2
	bool "ARC PS/2 support"
	default n
	depends on SERIO && ARC_BOARD_ANGEL4
	help
	  ARC FPGA Peripherals PS/2 support. Driver currently works only
	  on AA4 board.

config ARC_PS2_DEBUG
	bool "ARC PS/2 driver debugging"
	default n
	depends on ARC_PS2
	help
	  Turn on statistic collection and various debug messages to
	  simplify debugging.

config ARCTANGENT_EMAC
	tristate "ARCTangent EMAC support"
	select NET
	select INET
	select NETDEVICES
	select NET_ETHERNET
	default n
	depends on ARC_BOARD_ANGEL4

config EMAC_NAPI
	bool "Use NAPI ?"
	default n
	depends on ARCTANGENT_EMAC

config XILINX_TEMAC
	tristate "Use AA5 Xilinx TEMAC ?"
	default y
	select NET
	select INET
	select NETDEVICES
	select NET_ETHERNET
	depends on ARC_BOARD_ML509

config ISS_MAC
	tristate "Use xISS/ISS ENET simulation ?"
	default n
	select NET
	select IET
	select NETDEVICES
	select NET_ETHERNET
	depends on ARC_ISS_VIRT_PERIP

config ARCPGU
	tristate "Use ARC Pixel Graphics Unit"
	select FB
	select FB_CFB_FILLRECT
	select FB_CFB_COPYAREA
	select FB_CFB_IMAGEBLIT
	depends on ARCTANGENT_EMAC

config VFB_SIM
	bool "Use ISS/xISS framebuffer"
	select FB
	select FB_CFB_FILLRECT
	select FB_CFB_COPYAREA
	select FB_CFB_IMAGEBLIT
	select FB_SYS_FOPS
	depends on ARC_ISS_VIRT_PERIP

config VFB_SIM_BASE
	hex "Base address of Frame Buffer in Pysical memory"
	default "0x88000000"
	depends on VFB_SIM

config VFB_SIM_SIZE
	hex "Size of memory buffer"
	default "0x400000"
	depends on VFB_SIM

config VFB_SIM_XRES
	int "X-Resolution"
	default "640"
	depends on VFB_SIM

config VFB_SIM_YRES
	int "Y-Resolution"
	default "480"
	depends on VFB_SIM

config VFB_SIM_BPP
	int "Bits per pixel"
	default "16"
	depends on VFB_SIM

config FORCE_MAX_ZONEORDER
	int
	depends on ARCPGU || PGU_SIM
	default "13"

config ARCPGU_YUVBUFS
	int 'Number of YUV Buffers'
	default 18
	depends on ARCPGU || PGU_SIM

config ARCPGU_RGBBUFS
	int 'Number of RGB Buffers'
	default 2
	depends on ARCPGU || PGU_SIM

config ARCPGU_DISPTYPE
	int 'Display selector (0 - VGA, 1 - QVGA)'
	default 0
	depends on ARCPGU || PGU_SIM

config ARCPGU_XRES
	int 'Default YUV X resolution'
	default 640
	depends on ARCPGU || PGU_SIM

config ARCPGU_YRES
	int 'Default YUV Y resolution'
	default 480
	depends on ARCPGU || PGU_SIM

config ARCPGU_VCLK
	bool 'PLL-driven pixel clock'
	default 0
	depends on ARCPGU || PGU_SIM

config ARC_PGU_CONSOLE
	bool 'Console on the ARC PGU'
	depends on ARCPGU || PGU_SIM
	select FRAMEBUFFER_CONSOLE
	select FONTS
	select FONT_8x8
	select FONT_8x16
	select LOGO
	select LOGO_LINUX_MONO
	select LOGO_LINUX_VGA16
	select LOGO_LINUX_CLUT224
	select BACKLIGHT_LCD_SUPPORT

config ARCVSYNC
	bool
	depends on ARC_PGU_CONSOLE
	default y
```

## arch/arc/plat-arcfpga/Kconfig
```kconfig
#
# Copyright (C) 2004, 2007-2010, 2011-2012 Synopsys, Inc. (www.synopsys.com)
#
# This program is free software; you can redistribute it and/or modify
# it under the terms of the GNU General Public License version 2 as
# published by the Free Software Foundation.
#

# The FPGA platform is pretty simple, No real SoC, nothing SoC specific and a
# bunch of boards.


# ARC FPGA platform corresponds to a "generic" SOC.
config ARC_SOC_GENERIC
	def_bool y

# All ARC FPGA boards
choice
	prompt "FPGA Board"

config ARC_BOARD_ANGEL4
	bool "ARC Angel4"
	depends on ARC_SOC_GENERIC
	help
	  ARC Angel4 FPGA Ref Platform (Xilinx Virtex Based)

config ARC_BOARD_ML509
	bool "ML509"
	depends on ARC_SOC_GENERIC
	help
	  ARC ML509 FPGA Ref Platform (Xilinx Virtex-5 Based)

config ARC_ISS_VIRT_PERIP
	bool "ISS Virtual Peripherals"
	depends on ARC_SOC_GENERIC
	help
	  ARC Linux can run on ARC Instruction set Simulator.
	  The binary built for AA4/ML509 can run on ISS, despite lack of
	  peripherals since drivers check if they are on ISS vs. real H/w.
	  This config option is only used if you want to build ISS specific
	  virtual periperal drivers such as virt-framebuffer or virt-mac.

endchoice

# TBD: The drivers would eventually move into drivers/xxx folders
# Right now, this will make the "ARC Platform Menu cobbled up"
source "arch/arc/drivers/Kconfig"

# Platform specific IRQ wiring - tied to devices - feeds into non-plat-arc code
config ARC_TIMER_LV2
	bool "High Priority Timer0 IRQ"
	select ARC_IRQ3_LV2

# Timer HAS to be high priority, for any other high priority config
config ARC_SERIAL_LV2
	bool "High Priority Serial IRQ"
	depends on ARC_SERIAL && ARC_TIMER_LV2
	select ARC_IRQ5_LV2

config ARC_EMAC_LV2
	bool "High Priority EMAC IRQ"
	depends on ARCTANGENT_EMAC && ARC_TIMER_LV2
	select ARC_IRQ5_LV2

menuconfig ARC_HAS_BVCI_LAT_UNIT
	bool "BVCI Bus Latency Unit"
	depends on ARC_BOARD_ML509 || ARC_BOARD_ANGEL4
	help
	  IP to add artifical latency to BVCI Bus Based FPGA builds.
	  The default latency (even worst case) for FPGA is non-realistic
	  (~10 SDRAM, ~5 SSRAM).

config BVCI_LAT_UNITS
	hex "Latency Unit(s) Bitmap"
	default "0x0"
	depends on ARC_HAS_BVCI_LAT_UNIT
	help
	  There are multiple Latency Units corresponding to the many
	  interfaces of the system bus arbiter (both CPU side as well as
	  the peripheral side).
	  To add latency to ALL memory transaction, choose Unit 0, otherwise
	  for finer grainer - interface wise latency, specify a bitmap (1 bit
	  per unit) of all units. e.g. 1,2,12 will be 0x1003

	  Unit  0 - System Arb and Mem Controller
	  Unit  1 - I$ and System Bus
	  Unit  2 - D$ and System Bus
	  ..
	  Unit 12 - IDE Disk controller and System Bus

config BVCI_LAT_CYCLES
	int "Latency Value in cycles"
	range 0 63
	default "30"
	depends on ARC_HAS_BVCI_LAT_UNIT

config ARC_AHB_PCI_BRIDGE
    bool "AHB to PCI Bridge"
    default n
    select PCI
    depends on ARC_BOARD_ANGEL4
    help
    To Enable a PCI device to work on AA4 Ref Board

menu "Bus options (PCI etc.)"

config PCI
       bool "PCI support"
       default n
       help
         If you have PCI, say Y, otherwise N.

source "drivers/pci/Kconfig"
source "drivers/pci/hotplug/Kconfig"
source "drivers/pcmcia/Kconfig"

endmenu     # Bus options
```
